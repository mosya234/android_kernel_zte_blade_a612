## drivers/misc/mediatek/accelerometer/kxtj2-new/Kconfig
```kconfig
config MTK_KXTJ2_NEW
	bool "KXTJ2 for MediaTek package"
	default n
	help
	  It support different accelerometer sensor.
          If this option is set,
	  it will support
          KXTJ2 Accelerometer.
```

## drivers/misc/mediatek/accelerometer/lis2dh12/Kconfig
```kconfig
config MTK_LIS2DH12
	bool "ST LIS2DH12 for MediaTek package"
	default n
	help
	  It support different accelerometer sensor.
          If this option is set,
	  it will support
          LIS2DH12 Accelerometer.
```

## drivers/spi/mediatek/Kconfig
```kconfig
#SPI
config MTK_SPI
	tristate "MediaTek SPI controller"
	#depends on SPI
	default n
	---help---
	This selects the MediaTek(R) SPI bus driver.
	If you want to use MediaTek(R) SPI interface, say Y or M here.  If unsure, say N.
	
config FINGERPRINT_SUPPORT
	bool "fingerprint"
	default n
	---help---
	Select this option to support fingerprint core.

config FINGERPRINT_SYNAPTICS
	bool "syn"
	depends on INPUT && FINGERPRINT_SUPPORT
	help
	Select this option to support synaptics fingerprint chip. 

config FINGERPRINT_GF3208
	bool "gf3208(goodix fingerprint sensor)  for dewav"
	depends on INPUT && FINGERPRINT_SUPPORT
	help
	Select this option to support fingerprint gf3208 silead sensor.
```
